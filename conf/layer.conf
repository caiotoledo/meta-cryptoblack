## conf/layer.conf
```bitbake
# We have a conf and classes directory, add to BBPATH
BBPATH .= ":${LAYERDIR}"

# We have recipes-* directories, add to BBFILES
BBFILES += "${LAYERDIR}/recipes-*/*/*.bb \
	${LAYERDIR}/recipes-*/*/*.bbappend"

BBFILE_COLLECTIONS += "meta-cryptoblack"
BBFILE_PATTERN_meta-cryptoblack = "^${LAYERDIR}/"
BBFILE_PRIORITY_meta-cryptoblack = "6"
```

## conf/machine/beaglebone-green-wifi.conf
```bitbake
#@TYPE: Machine
#@NAME: BeagleBone Green Wireless
#@DESCRIPTION: Machine configuration for the BeagleBone Green Wireless

MACHINEOVERRIDES =. "beaglebone:"

KERNEL_DEVICETREE_append = " am335x-bonegreen-wireless.dtb"

require conf/machine/beaglebone.conf
```
